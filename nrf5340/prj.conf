## CMakeLists.txt
```
#
# Copyright (c) 2018 Nordic Semiconductor
#
# SPDX-License-Identifier: LicenseRef-Nordic-5-Clause
#
cmake_minimum_required(VERSION 3.20.0)

find_package(Zephyr REQUIRED HINTS $ENV{ZEPHYR_BASE})
project(NONE)

# NORDIC SDK APP START
target_sources(app PRIVATE
  src/main.h
  src/main.c
)


# NORDIC SDK APP END
zephyr_library_include_directories(.)
```

## sysbuild.conf
```
SB_CONFIG_PARTITION_MANAGER=n

SB_CONFIG_BOOTLOADER_MCUBOOT=y
```

## prj.conf
```kconfig
CONFIG_NCS_SAMPLES_DEFAULTS=y

# Logger module
CONFIG_LOG=y

# Bluetooth LE
CONFIG_BT=y
CONFIG_BT_PERIPHERAL=y
CONFIG_BT_DEVICE_NAME="Diplomska naloga"

# Buttons and LED library
CONFIG_BT_LBS=y
CONFIG_BT_LBS_POLL_BUTTON=y
CONFIG_DK_LIBRARY=y

# Increase stack size for the main thread and System Workqueue
CONFIG_SYSTEM_WORKQUEUE_STACK_SIZE=2048

CONFIG_NCS_SAMPLE_MCUMGR_BT_OTA_DFU=y
```

## src/main.c
```c
#include "main.h"

LOG_MODULE_REGISTER(Diploma, LOG_LEVEL_INF);

static void btAdvFunction(struct k_work *work){
	int err = bt_le_adv_start(
		bluetoothParams, 
		advertisingData, 
		ARRAY_SIZE(advertisingData), 
		scanData, 
		ARRAY_SIZE(scanData)
	);
	if (err) {
		LOG_ERR("Advertising failed to start (err %d)\n", err);
		return;
	}
	LOG_INF("Advertising successfully started\n");
}

void advertisingTask(){
	k_work_submit(&advTask);
}

static void connected(struct bt_conn *conn, uint8_t err){
	if (err) {
		printk("Connection failed, err 0x%02x %s\n", err, bt_hci_err_to_str(err));
		return;
	}
	printk("Connected\n");
}

static void disconnected(struct bt_conn *conn, uint8_t reason){
	printk("Disconnected, reason 0x%02x %s\n", reason, bt_hci_err_to_str(reason));
}

static void recycled_cb(void){
	printk("Connection object available from previous conn. Disconnect is complete!\n");
	advertisingTask();
}

// Defining which function to use upon an event
BT_CONN_CB_DEFINE(conn_callbacks) = {
	.connected        = connected,
	.disconnected     = disconnected,
	.recycled         = recycled_cb,
};

int main(void){
	int blink_status = 0;
	int err;

	bt_addr_le_t addr;
    err = bt_addr_le_from_str("FF:EE:DD:CC:BB:AA", "random", &addr);
    if (err) {
        printk("Invalid BT address (err %d)\n", err);
    }

    err = bt_id_create(&addr, NULL);
    if (err < 0) {
        printk("Creating new ID failed (err %d)\n", err);
    }
	
	err = bt_enable(NULL);
	if (err) {
		LOG_ERR("Bluetooth init failed (err %d)\n", err);
		return -1;
	}

	LOG_INF("Bluetooth initialized\n");

	err = dk_leds_init();
    if (err < 0) {
        printk("Unnable to initialize LED (err %d)\n", err);
    }
	
	
	k_work_init(&advTask, btAdvFunction);
	advertisingTask();
	for (;;) {
		dk_set_led(RUN_STATUS_LED, (++blink_status) % 2);
		k_sleep(K_MSEC(RUN_LED_BLINK_INTERVAL));
	}
}
```

## src/main.h
```c
#include <zephyr/kernel.h>
#include <zephyr/logging/log.h>

#include <dk_buttons_and_leds.h>

#include <bluetooth/services/lbs.h>

#include <zephyr/bluetooth/bluetooth.h>

#include <zephyr/bluetooth/hci.h>
#include <zephyr/bluetooth/conn.h>
#include <zephyr/bluetooth/gatt.h>
#include <zephyr/bluetooth/gap.h>
#include <zephyr/bluetooth/uuid.h>
#include <zephyr/bluetooth/addr.h>

#define DEVICE_NAME CONFIG_BT_DEVICE_NAME
#define DEVICE_NAME_LEN (sizeof(DEVICE_NAME) - 1)

#define RUN_STATUS_LED DK_LED1
#define RUN_LED_BLINK_INTERVAL 1000

static const struct bt_le_adv_param *bluetoothParams = BT_LE_ADV_PARAM(
    BT_LE_ADV_OPT_CONN, 
    BT_GAP_ADV_FAST_INT_MIN_2, 
    BT_GAP_ADV_FAST_INT_MAX_2, 
    NULL
);

// Advertising data
static const struct bt_data advertisingData[] = {
	BT_DATA_BYTES(BT_DATA_FLAGS, (BT_LE_AD_GENERAL | BT_LE_AD_NO_BREDR)),
	BT_DATA(BT_DATA_NAME_COMPLETE, DEVICE_NAME, DEVICE_NAME_LEN),
};

// Scan response data
static const struct bt_data scanData[] = {
};

// Function to start the bluetooth advertising
static void btAdvFunction(struct k_work *work);

static struct k_work advTask;

// Function that initializes the task via k_work_submit
void advertisingTask();
```
